## boards/asr/asr6502/Kconfig.asr6502
```kconfig
# Copyright (c) 2025 hal_ASR6502 contributors
# SPDX-License-Identifier: Apache-2.0

config BOARD_ASR6502
	select SOC_ASR6502
```

## boards/asr/asr6502/board.yml
```yaml
# Copyright (c) 2025 hal_ASR6502 contributors
# SPDX-License-Identifier: Apache-2.0

board:
  name: asr6502
  full_name: ASR6502
  vendor: asr
  socs:
    - name: asr6502
```

## boards/asr/lht52/Kconfig.lht52
```kconfig
# Copyright (c) 2025 hal_ASR6502 contributors
# SPDX-License-Identifier: Apache-2.0

config BOARD_LHT52
	select SOC_ASR6502
```

## boards/asr/lht52/board.yml
```yaml
board:
  name: lht52
  full_name: Dragino LHT52
  vendor: asr
  socs:
  - name: asr6502
```

## drivers/adc/Kconfig
```kconfig
# Copyright (c) 2025 hal_ASR6502 contributors
# SPDX-License-Identifier: Apache-2.0

config ADC_ASR6502
	bool "ASR6502 SAR ADC driver"
	default y
	depends on ADC
	depends on DT_HAS_ASR_ASR6502_SAR_ENABLED
	select ADC_CONFIGURABLE_INPUTS
	help
	  Enable the SAR ADC driver for the ASR6502 (single-ended and differential
	  channels, hardware averaging, interrupt-driven acquisition).
```

## drivers/counter/Kconfig
```kconfig
# Copyright (c) 2025 hal_ASR6502 contributors
# SPDX-License-Identifier: Apache-2.0

config COUNTER_ASR6502
	bool "ASR6502 WDT counter driver"
	default y
	depends on COUNTER
	depends on DT_HAS_ASR_ASR6502_COUNTER_ENABLED
	help
	  Enable the ILO/watchdog-based counter for the ASR6502 (a deep-sleep-capable
	  wake timer). Enabling it disables the watchdog reset function.
```

## drivers/flash/Kconfig
```kconfig
# Copyright (c) 2025 hal_ASR6502 contributors
# SPDX-License-Identifier: Apache-2.0

config FLASH_ASR6502
	bool "ASR6502 internal flash driver"
	default y
	depends on FLASH
	depends on DT_HAS_ASR_ASR6502_FLASH_ENABLED
	select FLASH_HAS_PAGE_LAYOUT
	select FLASH_HAS_DRIVER_ENABLED
	help
	  Internal flash program/erase via the PSoC4 SROM system calls.
```

## drivers/gpio/Kconfig
```kconfig
# Copyright (c) 2025 hal_ASR6502 contributors
# SPDX-License-Identifier: Apache-2.0

config GPIO_ASR6502
	bool "ASR6502 GPIO driver"
	default y
	depends on GPIO
	depends on DT_HAS_ASR_ASR6502_GPIO_ENABLED
	help
	  Enable the GPIO driver for ASR6502 ports.
```

## drivers/hwinfo/Kconfig
```kconfig
# Copyright (c) 2025 hal_ASR6502 contributors
# SPDX-License-Identifier: Apache-2.0

config HWINFO_ASR6502
	bool "ASR6502 hwinfo"
	default y
	depends on HWINFO
	depends on SOC_FAMILY_ASR
	help
	  Enable the ASR6502 hwinfo backend (reset cause and silicon ID).
```

## drivers/serial/Kconfig
```kconfig
# Copyright (c) 2025 hal_ASR6502 contributors
# SPDX-License-Identifier: Apache-2.0

config UART_ASR6502
	bool "ASR6502 SCB UART driver"
	default y
	depends on SERIAL
	depends on DT_HAS_ASR_ASR6502_UART_ENABLED
	select PINCTRL
	help
	  Enable the polling SCB UART driver for the ASR6502.
```

## drivers/spi/Kconfig
```kconfig
# Copyright (c) 2025 hal_ASR6502 contributors
# SPDX-License-Identifier: Apache-2.0

config SPI_ASR6502
	bool "ASR6502 SCB SPI driver"
	default y
	depends on SPI
	depends on DT_HAS_ASR_ASR6502_SPI_ENABLED
	select PINCTRL
	help
	  Enable the polling SCB SPI master driver for the ASR6502 (the on-die
	  SX126x radio bus).
```

## drivers/watchdog/Kconfig
```kconfig
# Copyright (c) 2025 hal_ASR6502 contributors
# SPDX-License-Identifier: Apache-2.0

config WDT_ASR6502
	bool "ASR6502 watchdog driver"
	default y
	depends on WATCHDOG
	depends on DT_HAS_ASR_ASR6502_WATCHDOG_ENABLED
	help
	  Enable the ILO/WDT watchdog for the ASR6502. Shares the WDT hardware with
	  the counter driver; enable only one of them.
```

## dts/bindings/adc/asr,asr6502-sar.yaml
```yaml
# Copyright (c) 2025 hal_ASR6502 contributors
# SPDX-License-Identifier: Apache-2.0

description: |
  ASR6502 SAR ADC controller.

  Channels are described as child nodes per the Zephyr ADC controller binding;
  "zephyr,input-positive" (and "zephyr,input-negative" for differential channels)
  are SARMUX input pin numbers (0..7).

compatible: "asr,asr6502-sar"

include: [adc-controller.yaml, base.yaml]

properties:
  reg:
    required: true

  interrupts:
    required: true

  vref-mv:
    type: int
    required: true
    description: Reference voltage in millivolts, used for raw-to-millivolt conversion.

  vref-sel:
    type: int
    default: 0
    description: |
      Value for CTRL.VREF_SEL (3-bit). Selects the SAR reference; the encoding is
      device-specific, see the ASR6502/PSoC 4 datasheet.

  sample-time:
    type: int
    default: 20
    description: Default sample aperture ST0 in ADC clock cycles (10-bit).

  "#io-channel-cells":
    const: 1

io-channel-cells:
  - input
```

## dts/bindings/counter/asr,asr6502-counter.yaml
```yaml
# Copyright (c) 2025 hal_ASR6502 contributors
# SPDX-License-Identifier: Apache-2.0

description: |
  ASR6502 watchdog-based counter. A free-running 16-bit ILO counter whose match
  interrupt can wake the SoC from deep sleep. Enabling it disables the watchdog
  reset function.

compatible: "asr,asr6502-counter"

include: [base.yaml]

properties:
  reg:
    required: true

  interrupts:
    required: true
```

## dts/bindings/gpio/asr,asr6502-gpio.yaml
```yaml
# Copyright (c) 2025 hal_ASR6502 contributors
# SPDX-License-Identifier: Apache-2.0

description: ASR6502 GPIO port

compatible: "asr,asr6502-gpio"

include: [gpio-controller.yaml, base.yaml]

properties:
  reg:
    required: true

  ngpios:
    const: 8

  "#gpio-cells":
    const: 2

gpio-cells:
  - pin
  - flags
```

## dts/bindings/mtd/asr,asr6502-flash.yaml
```yaml
# Copyright (c) 2025 hal_ASR6502 contributors
# SPDX-License-Identifier: Apache-2.0

description: ASR6502 (PSoC4100S+) internal flash controller

compatible: "asr,asr6502-flash"

include: flash-controller.yaml

properties:
  reg:
    required: true
```

## dts/bindings/pinctrl/asr,asr6502-pinctrl.yaml
```yaml
# Copyright (c) 2025 hal_ASR6502 contributors
# SPDX-License-Identifier: Apache-2.0

description: |
  ASR6502 pin controller (HSIOM). Each child node describes one pin as
  pinmux = <ASR_PINMUX(port, pin, hsiom-sel)> plus optional generic drive/bias
  properties. Reference the pins from a device via pinctrl-0.

    #include <zephyr/dt-bindings/pinctrl/asr6502-pinctrl.h>

    &pinctrl {
      uart1_tx: uart1_tx {
        pinmux = <ASR_PINMUX(4, 0, 9)>;
        drive-push-pull;
      };
      uart1_rx: uart1_rx {
        pinmux = <ASR_PINMUX(4, 1, 9)>;
        input-enable;
      };
    };

compatible: "asr,asr6502-pinctrl"

include: base.yaml

properties:
  reg:
    required: true

child-binding:
  description: ASR6502 pin configuration.
  include: pincfg-node.yaml
  properties:
    pinmux:
      required: true
      type: array
      description: Pin routing, packed with ASR_PINMUX(port, pin, hsiom-sel).
```

## dts/bindings/serial/asr,asr6502-uart.yaml
```yaml
# Copyright (c) 2025 hal_ASR6502 contributors
# SPDX-License-Identifier: Apache-2.0

description: |
  ASR6502 SCB in UART mode (polling, 8N1). TX/RX pins are routed through the
  pin controller; reference them with pinctrl-0 (see asr,asr6502-pinctrl).

compatible: "asr,asr6502-uart"

include: [uart-controller.yaml, pinctrl-device.yaml]

properties:
  reg:
    required: true

  current-speed:
    required: true

  pinctrl-0:
    required: true

  pinctrl-names:
    required: true
```

## dts/bindings/spi/asr,asr6502-spi.yaml
```yaml
# Copyright (c) 2025 hal_ASR6502 contributors
# SPDX-License-Identifier: Apache-2.0

description: ASR6502 SCB SPI master (polling, 8-bit, MSB first).

compatible: "asr,asr6502-spi"

include: [spi-controller.yaml, pinctrl-device.yaml]

properties:
  reg:
    required: true

  pinctrl-0:
    required: true

  pinctrl-names:
    required: true
```

## dts/bindings/watchdog/asr,asr6502-watchdog.yaml
```yaml
# Copyright (c) 2025 hal_ASR6502 contributors
# SPDX-License-Identifier: Apache-2.0

description: |
  ASR6502 watchdog (ILO-clocked WDT). Shares hardware with the counter driver;
  enable only one of them.

compatible: "asr,asr6502-watchdog"

include: [base.yaml]

properties:
  reg:
    required: true
```

## soc/asr/Kconfig
```kconfig
# Copyright (c) 2025 hal_ASR6502 contributors
# SPDX-License-Identifier: Apache-2.0

config SOC_FAMILY_ASR
	select ARM
	select CPU_CORTEX_M0PLUS
	select CPU_CORTEX_M_HAS_SYSTICK
	select CPU_CORTEX_M_HAS_VTOR
	select HAS_ASR6502_SDK
	select SOC_EARLY_INIT_HOOK
```
