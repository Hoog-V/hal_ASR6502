## soc/asr/Kconfig.soc
```kconfig
# Copyright (c) 2025 hal_ASR6502 contributors
# SPDX-License-Identifier: Apache-2.0

config SOC_FAMILY_ASR
	bool

config SOC_FAMILY
	default "asr" if SOC_FAMILY_ASR

config SOC_ASR6502
	bool
	select SOC_FAMILY_ASR
	help
	  ASR6502: Arm Cortex-M0+ (PSoC 4100S core) with an integrated SX126x radio.

config SOC
	default "asr6502" if SOC_ASR6502
```

## zephyr/Kconfig
```kconfig
# Copyright (c) 2025 hal_ASR6502 contributors
# SPDX-License-Identifier: Apache-2.0

config HAS_ASR6502_SDK
	bool
	help
	  Build the ASR6502 HAL (BSP) sources. Selected by an ASR6502-based SoC.

rsource "../drivers/gpio/Kconfig"
rsource "../drivers/adc/Kconfig"
rsource "../drivers/counter/Kconfig"
rsource "../drivers/hwinfo/Kconfig"
rsource "../drivers/watchdog/Kconfig"
rsource "../drivers/serial/Kconfig"
```
